## CifradoCesar/CifradoCesar/esp/client/main/Kconfig.projbuild
```kconfig
menu "App Configuration"

config WIFI_SSID
    string "WiFi SSID"
    default "S25 Ultra de Carlos"

config WIFI_PASSWORD
    string "WiFi Password"
    default "carlos21"

config TCP_SERVER_IP
    string "TCP server IP"
    default "10.91.121.104"

config TCP_SERVER_PORT
    int "TCP server port"
    range 1 65535
    default 3333

config CAESAR_SHIFT
    int "Caesar shift (0-25)"
    range 0 25
    default 4

config CAESAR_TEXT
    string "Caesar plaintext"
    default "Jaime_123"

endmenu
```

## CifradoCesar/CifradoCesar/esp/server/main/Kconfig.projbuild
```kconfig
menu "App Configuration"

config WIFI_SSID
    string "WiFi SSID"
    default "TP-Link_393B"

config WIFI_PASSWORD
    string "WiFi Password"
    default "17621892"

config TCP_SERVER_PORT
    int "TCP server port"
    range 1 65535
    default 3333

endmenu
```

## CifradoCesar/esp/client/main/Kconfig.projbuild
```kconfig
menu "App Configuration"

config WIFI_SSID
    string "WiFi SSID"
    default "TP-Link_68CC"

config WIFI_PASSWORD
    string "WiFi Password"
    default "36415892"

config TCP_SERVER_IP
    string "TCP server IP"
    default "192.168.0.109"

config TCP_SERVER_PORT
    int "TCP server port"
    range 1 65535
    default 3333

config CAESAR_SHIFT
    int "Caesar shift (0-25)"
    range 0 25
    default 4

config CAESAR_TEXT
    string "Caesar plaintext"
    default "Jaime_123"

endmenu
```

## CifradoCesar/esp/client/sdkconfig.defaults
```kconfig
CONFIG_ESPTOOLPY_BAUD_921600=y
CONFIG_TCPIP_LWIP=y
# Ajusta por menuconfig en primera build:
# CONFIG_WIFI_SSID="TuSSID"
# CONFIG_WIFI_PASS="TuPASS"
# CONFIG_TCP_SERVER_IP="192.168.1.80"
# CONFIG_TCP_SERVER_PORT=3333
# CONFIG_CAESAR_SHIFT=4
# CONFIG_CAESAR_TEXT="Bren_123"
```

## CifradoCesar/esp/server/sdkconfig.defaults
```kconfig
CONFIG_WIFI_SSID="TP-Link_393B"
CONFIG_WIFI_PASSWORD="17621892"
CONFIG_TCP_SERVER_PORT=3333
```
